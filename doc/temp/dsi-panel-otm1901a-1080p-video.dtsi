/* Copyright (c) 2013, The Linux Foundation. All rights reserved.
 *
 * This program is free software; you can redistribute it and/or modify
 * it under the terms of the GNU General Public License version 2 and
 * only version 2 as published by the Free Software Foundation.
 *
 * This program is distributed in the hope that it will be useful,
 * but WITHOUT ANY WARRANTY; without even the implied warranty of
 * MERCHANTABILITY or FITNESS FOR A PARTICULAR PURPOSE.  See the
 * GNU General Public License for more details.
 */

/*---------------------------------------------------------------------------
 * This file is autogenerated file using gcdb parser. Please do not edit it.
 * Update input XML file to add a new entry or update variable in this file
 * VERSION = "1.0"
 *---------------------------------------------------------------------------*/
&mdss_mdp {
	dsi_otm1901a_1080p_video: qcom,mdss_dsi_otm1901a_1080p_video {
		qcom,mdss-dsi-panel-name = "otm1901a 1080p video mode dsi panel";
		qcom,mdss-dsi-panel-controller = <&mdss_dsi0>;
		qcom,mdss-dsi-panel-type = "dsi_video_mode";
		qcom,mdss-dsi-panel-destination = "display_1";
		qcom,mdss-dsi-panel-framerate = <60>;
		qcom,mdss-dsi-virtual-channel-id = <0>;
		qcom,mdss-dsi-stream = <0>;
		qcom,mdss-dsi-panel-width = <1080>;
		qcom,mdss-dsi-panel-height = <1920>;
		qcom,mdss-dsi-h-front-porch = <50>; // 32
		qcom,mdss-dsi-h-back-porch = <50>; // 32
		qcom,mdss-dsi-h-pulse-width = <10>; // 4
		//qcom,mdss-dsi-h-sync-pulse = <0>;
		qcom,mdss-dsi-h-sync-skew = <0>;
		qcom,mdss-dsi-v-back-porch = <20>; // 9
		qcom,mdss-dsi-v-front-porch = <20>; // 14
		qcom,mdss-dsi-v-pulse-width = <4>; // 1
		qcom,mdss-dsi-h-left-border = <0>;
		qcom,mdss-dsi-h-right-border = <0>;
		qcom,mdss-dsi-v-top-border = <0>;
		qcom,mdss-dsi-v-bottom-border = <0>;
		qcom,mdss-dsi-bpp = <24>;
		qcom,mdss-dsi-color-order = "rgb_swap_rgb";
		qcom,mdss-dsi-underflow-color = <0xff>;
		qcom,mdss-dsi-border-color = <0>;
		qcom,mdss-dsi-pixel-packing = "tight";
		qcom,mdss-dsi-on-command = [
			39 01 00 00 00 00 02 00 00 
			39 01 00 00 00 00 05 FF 19 01 01 00 
			39 01 00 00 00 00 02 00 80 
			39 01 00 00 00 00 03 FF 19 01 
			39 01 00 00 00 00 02 00 00 
			39 01 00 00 00 00 02 1C 33 
			39 01 00 00 00 00 02 00 A0 
			39 01 00 00 00 00 02 C1 E8 
			39 01 00 00 00 00 02 00 A7 
			39 01 00 00 00 00 02 C1 00 
			39 01 00 00 00 00 02 00 90 
			39 01 00 00 00 00 07 C0 00 2F 00 00 00 01 
			39 01 00 00 00 00 02 00 C0 
			39 01 00 00 00 00 07 C0 00 2F 00 00 00 01 
			39 01 00 00 00 00 02 00 9A 
			39 01 00 00 00 00 02 C0 1E 
			39 01 00 00 00 00 02 00 AC 
			39 01 00 00 00 00 02 C0 06 
			39 01 00 00 00 00 02 00 DC 
			39 01 00 00 00 00 02 C0 06 
			39 01 00 00 00 00 02 00 81 
			39 01 00 00 00 00 02 A5 06 
			39 01 00 00 00 00 02 00 82 
			39 01 00 00 00 00 02 C4 F0 
			39 01 00 00 00 00 02 00 92 
			39 01 00 00 00 00 02 E9 00 
			39 01 00 00 00 00 02 00 90 
			39 01 00 00 00 00 02 F3 01 
			39 01 00 00 00 00 02 00 82 
			39 01 00 00 00 00 02 A5 1F 
			39 01 00 00 00 00 02 00 93 
			39 01 00 00 00 00 02 C5 1E 
			39 01 00 00 00 00 02 00 95 
			39 01 00 00 00 00 02 C5 2D 
			39 01 00 00 00 00 02 00 97 
			39 01 00 00 00 00 02 C5 19 
			39 01 00 00 00 00 02 00 99 
			39 01 00 00 00 00 02 C5 28 
			39 01 00 00 00 00 02 00 9B 
			39 01 00 00 00 00 03 C5 43 30 
			39 01 00 00 00 00 02 00 9D 
			39 01 00 00 00 00 02 C5 68 
			39 01 00 00 00 00 02 00 00 
			39 01 00 00 00 00 03 D8 1C 1C 
			39 01 00 00 00 00 02 00 a8
			39 01 00 00 00 00 02 C4 11 
			39 01 00 00 00 00 02 00 C2
			39 01 00 00 00 00 02 C5 12 
			39 01 00 00 00 00 02 00 B3 
			39 01 00 00 00 00 02 C0 CC 
			39 01 00 00 00 00 02 00 BC 
			39 01 00 00 00 00 02 C0 00 
			39 01 00 00 00 00 02 00 84 
			39 01 00 00 00 00 02 C4 22 
			39 01 00 00 00 00 02 00 94 
			39 01 00 00 00 00 02 C1 84 
			39 01 00 00 00 00 02 00 98 
			39 01 00 00 00 00 02 C1 74 
			39 01 00 00 00 00 02 00 80 
			39 01 00 00 00 00 02 C4 36 
			39 01 00 00 00 00 02 00 CD 
			39 01 00 00 00 00 02 F5 19 
			39 01 00 00 00 00 02 00 DB 
			39 01 00 00 00 00 02 F5 19 
			39 01 00 00 00 00 02 00 F5 
			39 01 00 00 00 00 02 C1 40 
			39 01 00 00 00 00 02 00 B9 
			39 01 00 00 00 00 02 C0 11 
			39 01 00 00 00 00 02 00 8D 
			39 01 00 00 00 00 02 F5 20 
			39 01 00 00 00 00 02 00 80 
			39 01 00 00 00 00 0F C0 00 7F 00 0A 0A 00 7F 0A 0A 00 7F 00 0A 0A 
			39 01 00 00 00 00 02 00 F0 
			39 01 00 00 00 00 07 C3 00 00 00 00 00 80 
			39 01 00 00 00 00 02 00 A0 
			39 01 00 00 00 00 08 C0 00 00 0E 00 00 1E 06 
			39 01 00 00 00 00 02 00 D0 
			39 01 00 00 00 00 08 C0 00 00 0E 00 00 1E 06 
			39 01 00 00 00 00 02 00 90 
			39 01 00 00 00 00 05 C2 84 01 3B 40 
			39 01 00 00 00 00 02 00 B0 
			39 01 00 00 00 00 09 C2 02 01 45 43 02 01 45 43 
			39 01 00 00 00 00 02 00 80 
			39 01 00 00 00 00 0d C3 84 08 03 00 0D 06 82 08 03 00 0D 06 
			39 01 00 00 00 00 02 00 90 
			39 01 00 00 00 00 0d C3 83 08 03 00 0D 06 81 08 03 00 0D 06 
			39 01 00 00 00 00 02 00 80 
			39 01 00 00 00 00 10 CC 09 0D 11 12 13 14 15 16 17 18 0E 28 28 28 28 
			39 01 00 00 00 00 02 00 90 
			39 01 00 00 00 00 10 CC 0D 09 14 13 12 11 15 16 17 18 0E 28 28 28 28 
			39 01 00 00 00 00 02 00 A0 
			39 01 00 00 00 00 10 CC 1D 1E 1F 19 1A 1B 1C 20 21 22 23 24 25 26 27 
			39 01 00 00 00 00 02 00 B0 
			39 01 00 00 00 00 09 CC 01 02 03 05 06 07 04 08 
			39 01 00 00 00 00 02 00 C0 
			39 01 00 00 00 00 0d CC 00 00 00 00 00 00 00 00 00 00 00 77 
			39 01 00 00 00 00 02 00 D0 
			39 01 00 00 00 00 0d CC FF 0F 30 C0 0F 30 00 00 33 03 00 77 
			39 01 00 00 00 00 02 00 DE 
			39 01 00 00 00 00 02 CC 00 
			39 01 00 00 00 00 02 00 80 
			39 01 00 00 00 00 10 CB 00 00 00 00 00 00 00 00 00 00 30 00 00 00 00 
			39 01 00 00 00 00 02 00 90 
			39 01 00 00 00 00 10 CB 30 00 C0 00 00 00 00 00 00 00 00 00 00 00 00 
			39 01 00 00 00 00 02 00 A0 
			39 01 00 00 00 00 10 CB 15 15 05 F5 05 F5 00 00 00 00 15 00 00 00 00 
			39 01 00 00 00 00 02 00 B0 
			39 01 00 00 00 00 10 CB 00 01 FD 00 00 00 00 00 00 00 00 00 00 00 00 
			39 01 00 00 00 00 02 00 C0 
			39 01 00 00 00 00 09 CB 00 00 00 00 00 00 77 77 
			39 01 00 00 00 00 02 00 D0 
			39 01 00 00 00 00 09 CB 00 00 00 00 00 00 77 77 
			39 01 00 00 00 00 02 00 E0 
			39 01 00 00 00 00 09 CB 00 00 00 01 01 01 77 77 
			39 01 00 00 00 00 02 00 F0 
			39 01 00 00 00 00 09 CB 11 11 11 11 11 11 77 77 
			39 01 00 00 00 00 02 00 80 
			39 01 00 00 00 00 10 CD 3F 3F 3F 3F 3F 3F 3F 3F 01 12 11 03 04 0B 17 
			39 01 00 00 00 00 02 00 90 
			39 01 00 00 00 00 0c CD 3D 02 3D 25 25 25 1F 20 21 25 25 
			39 01 00 00 00 00 02 00 A0 
			39 01 00 00 00 00 10 CD 3F 3F 3F 3F 3F 3F 3F 3F 01 12 11 05 06 0B 17 
			39 01 00 00 00 00 02 00 B0 
			39 01 00 00 00 00 0c CD 17 02 3D 25 25 25 1F 20 21 25 25 
			39 01 00 00 00 00 02 00 D4 
			39 01 00 00 00 00 05 C3 01 01 01 01 
			39 01 00 00 00 00 02 00 F7 
			39 01 00 00 00 00 05 C3 04 1B 00 00 
			39 01 00 00 00 00 02 00 F2 
			39 01 00 00 00 00 04 C1 80 0F 0F 
			39 01 00 00 00 00 02 00 00 
			39 01 00 00 00 00 04 FF FF FF FF 
			05 01 00 00 B4 00 02 11 00
			05 01 00 00 96 00 02 29 00
			];
		qcom,mdss-dsi-off-command = [
			05 01 00 00 32 00 02 28 00
			05 01 00 00 78 00 02 10 00];
		qcom,mdss-dsi-on-command-state = "dsi_lp_mode";
		qcom,mdss-dsi-off-command-state = "dsi_hs_mode";	
		qcom,mdss-dsi-traffic-mode = "burst_mode";
		qcom,mdss-dsi-lane-map = "lane_map_0123";
		qcom,mdss-dsi-bllp-eof-power-mode;
		qcom,mdss-dsi-lane-0-state;
		qcom,mdss-dsi-lane-1-state;
		qcom,mdss-dsi-lane-2-state;
		qcom,mdss-dsi-lane-3-state;
		qcom,mdss-dsi-panel-timings = [DB 34 22 00 64 66 28 38 2B 03 04 00];
		qcom,mdss-dsi-t-clk-post = <0x03>;
		qcom,mdss-dsi-t-clk-pre = <0x29>;
		qcom,mdss-dsi-bl-min-level = <1>;
		qcom,mdss-dsi-bl-max-level = <255>;
		qcom,mdss-dsi-bl-pmic-pwm-frequency = <20>;
		qcom,mdss-dsi-bl-pmic-bank-select = <0>;
		qcom,mdss-dsi-dma-trigger = "trigger_sw";
		qcom,mdss-dsi-mdp-trigger = "none";
		qcom,mdss-dsi-bl-pmic-control-type = "bl_ctrl_pwm";
		qcom,mdss-dsi-pwm-gpio = <&pm8916_mpps 4 0>;
		qcom,mdss-dsi-reset-sequence = <1 200>, <0 200>, <1 200>;
	};
};

